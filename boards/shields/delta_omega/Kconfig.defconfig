## boards/shields/delta_omega/Kconfig.defconfig
```kconfig
if SHIELD_DELTA_OMEGA_DONGLE

config ZMK_KEYBOARD_NAME
    default "Delta Omega"

config ZMK_SPLIT_ROLE_CENTRAL
    default y

endif

if SHIELD_DELTA_OMEGA_LEFT || SHIELD_DELTA_OMEGA_RIGHT || SHIELD_DELTA_OMEGA_DONGLE

config ZMK_SPLIT
    default y

endif
```
